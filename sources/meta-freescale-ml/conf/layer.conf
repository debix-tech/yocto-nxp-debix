## sources/meta-freescale-ml/conf/layer.conf
```bitbake
# We have a conf and classes directory, add to BBPATH
BBPATH .= ":${LAYERDIR}"

# We have a packages directory, add to BBFILES
BBFILES += "${LAYERDIR}/recipes-*/*/*.bb \
            ${LAYERDIR}/recipes-*/*/*.bbappend"

BBFILE_COLLECTIONS += "meta-freescale-ml"
BBFILE_PATTERN_meta-freescale-ml := "^${LAYERDIR}/"
BBFILE_PRIORITY_meta-freescale-ml = "8"
LAYERSERIES_COMPAT_meta-freescale-ml = "mickledore nanbield scarthgap styhead walnascar"
LAYERDEPENDS_meta-freescale-ml = "freescale-layer meta-python"
```

## sources/meta-nxp-connectivity/meta-nxp-matter-advanced/conf/machine/imx93evk-iwxxx-matter.conf
```bitbake
#@TYPE: Machine
#@NAME: A consolidated IW612 MATTER machine for i.MX 93 EVK
#@SOC: i.MX93
#@MAINTAINER: Jean-Yves Salaün <jean-yves.salaun@nxp.com>

MACHINEOVERRIDES =. "imx93-11x11-lpddr4x-evk:"
require conf/machine/imx93-11x11-lpddr4x-evk.conf

DELTA_KERNEL_DEFCONFIG="${UNPACKDIR}/kernel-config/*"
# Include device trees for other boards for internal test
KERNEL_DEVICETREE += " \
        freescale/imx93-11x11-evk-lpuart5-bt-115200-ffu-gpio-irq.dtb \
        freescale/imx93-11x11-frdm.dtb \
        freescale/imx93-14x14-evk.dtb \
        freescale/imx93-14x14-evk-rm67199.dtb \
        freescale/imx93-9x9-qsb.dtb \
        freescale/imx93-9x9-qsb-can1.dtb \
        freescale/imx93-9x9-qsb-flexspi-m2.dtb \
        freescale/imx93-9x9-qsb-i3c.dtb \
        freescale/imx93-9x9-qsb-lpspi.dtb \
        freescale/imx93-9x9-qsb-lpspi-slave.dtb \
        freescale/imx93-9x9-qsb-mt9m114.dtb \
        freescale/imx93-9x9-qsb-ontat-wvga-panel.dtb \
"
DTS_FILE="${BSPDIR}/sources/meta-nxp-connectivity/meta-nxp-otbr/recipes-kernel/linux/files/dts/imx93-11x11-evk-lpuart5-bt-115200-ffu-gpio-irq.dts ${BSPDIR}/sources/meta-nxp-connectivity/meta-nxp-otbr/recipes-kernel/linux/files/dts/imx93-11x11-frdm.dts"

UBOOT_DELTA_CONFIG="${UNPACKDIR}/uboot-config/*"

IMAGE_INSTALL:append = " packagegroup-nxp-matter-baseline packagegroup-nxp-openthread packagegroup-nxp-otbr packagegroup-nxp-zigbee-rcp docker-moby "

# Set to true to enable EdgeLock Enclave
USE_ELE = "true"

# Indicates the machine supports IWxxx modules
MACHINE_FEATURES += "has-iwxxx"
```

## sources/meta-nxp-connectivity/meta-nxp-matter-advanced/conf/machine/imx95-15x15-evk-iwxxx-matter.conf
```bitbake
#@TYPE: Machine
#@NAME: i.MX 95 15x15 Consolidated Machine For Matter
#@DESCRIPTION: A consolidated machine for i.MX 95 15x15 LPDDR4X EVK Matter demos
#@MAINTAINER: Haoran Wang <elven.wang@nxp.com>

MACHINEOVERRIDES =. "imx95-15x15-lpddr4x-evk:"
require conf/machine/imx95-15x15-lpddr4x-evk.conf
DELTA_KERNEL_DEFCONFIG="${UNPACKDIR}/kernel-config/*"
# Include device trees for other boards for internal test
KERNEL_DEVICETREE += " \
        freescale/imx95-15x15-evk-ffu_gpio_irq.dtb \
"
DTS_FILE="${BSPDIR}/sources/meta-nxp-connectivity/meta-nxp-otbr/recipes-kernel/linux/files/dts/imx95-15x15-evk-ffu_gpio_irq.dts"

UBOOT_DELTA_CONFIG="${UNPACKDIR}/uboot-config/*"

IMAGE_INSTALL:append = " packagegroup-nxp-matter-baseline packagegroup-nxp-openthread packagegroup-nxp-otbr packagegroup-nxp-zigbee-rcp docker-moby "

# Set to true to enable EdgeLock Enclave
USE_ELE = "true"

# Indicates the machine supports IWxxx modules
MACHINE_FEATURES += "has-iwxxx"
```

## sources/meta-nxp-connectivity/meta-nxp-matter-advanced/conf/machine/imx95-19x19-evk-iwxxx-matter.conf
```bitbake
#@TYPE: Machine
#@NAME: i.MX 95 19x19 Consolidated Machine For Matter
#@DESCRIPTION: A consolidated machine for i.MX 95 19x19 LPDDR5 EVK Matter demos
#@MAINTAINER: Haoran Wang <elven.wang@nxp.com>

MACHINEOVERRIDES =. "imx95-19x19-lpddr5-evk.conf:"
require conf/machine/imx95-19x19-lpddr5-evk.conf
DELTA_KERNEL_DEFCONFIG="${UNPACKDIR}/kernel-config/*"
## Include device trees for other boards for internal test
#KERNEL_DEVICETREE += " \
#        freescale/imx95-15x15-evk-ffu_gpio_irq.dtb \
#"
#DTS_FILE="${BSPDIR}/sources/meta-nxp-connectivity/meta-nxp-otbr/recipes-kernel/linux/files/dts/imx95-15x15-evk-ffu_gpio_irq.dts"

UBOOT_DELTA_CONFIG="${UNPACKDIR}/uboot-config/*"

IMAGE_INSTALL:append = " packagegroup-nxp-matter-baseline packagegroup-nxp-openthread packagegroup-nxp-otbr packagegroup-nxp-zigbee-rcp docker-moby "

# Set to true to enable EdgeLock Enclave
USE_ELE = "true"
```
